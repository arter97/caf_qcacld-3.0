## configs/mdm9607_qca9377_defconfig
```kconfig
CONFIG_QCA_CLD_WLAN=y
CONFIG_HANDLE_RX_REROUTE_ERR=y
CONFIG_QCA_WIFI_SDIO=y
CONFIG_WLAN_OPEN_SOURCE=y
CONFIG_WLAN_FEATURE_MBSSID=y
CONFIG_WLAN_FEATURE_P2P_P2P_STA=y
CONFIG_QCACLD_WLAN_LFR2=y
CONFIG_WLAN_TRACE_HIDE_MAC_ADDRESS_DISABLE=y
CONFIG_QCOM_TDLS=y
CONFIG_WLAN_SYSFS=y
CONFIG_THERMAL_STATS_SUPPORT=y
CONFIG_WLAN_SYSFS_STA_INFO=y
CONFIG_WLAN_SYSFS_CHANNEL=y
CONFIG_WLAN_SYSFS_CONNECT_INFO=y
CONFIG_WLAN_SYSFS_DCM=y
CONFIG_WLAN_SYSFS_RTS_CTS=y
CONFIG_WLAN_SYSFS_HE_BSS_COLOR=y
CONFIG_WLAN_SYSFS_DP_TRACE=y
CONFIG_WLAN_SYSFS_STATS=y
CONFIG_WLAN_SYSFS_TDLS_PEERS=y
CONFIG_WLAN_POWER_DEBUG=y
CONFIG_FEATURE_BECN_STATS=y
CONFIG_WLAN_FEATURE_MEDIUM_ASSESS=y
CONFIG_WLAN_DISABLE_EXPORT_SYMBOL=y
CONFIG_QCACLD_FEATURE_GREEN_AP=y
CONFIG_QCACLD_FEATURE_APF=y
CONFIG_QCACLD_FEATURE_FW_STATE=y
CONFIG_QCOM_VOWIFI_11R=y
CONFIG_WLAN_FEATURE_ACTION_OUI=y
CONFIG_ADAPTIVE_11R=y
CONFIG_SAE_SINGLE_PMK=y
CONFIG_FEATURE_MSCS=y
CONFIG_WLAN_FEATURE_FILS=y
CONFIG_QCOM_LTE_COEX=y
CONFIG_WLAN_FEATURE_LPSS=y
CONFIG_FEATURE_EPPING=y
CONFIG_WLAN_OFFLOAD_PACKETS=y
CONFIG_WLAN_SYNC_TSF=y
CONFIG_WLAN_FEATURE_DSRC=y
CONFIG_POWER_MANAGEMENT_OFFLOAD=y
CONFIG_LFR_SUBNET_DETECTION=y
CONFIG_MCC_TO_SCC_SWITCH=y
CONFIG_HL_DP_SUPPORT=y
CONFIG_QMI_SUPPORT=y
CONFIG_FEATURE_PKTLOG=y
CONFIG_WLAN_DEBUGFS=y
CONFIG_WLAN_MWS_INFO_DEBUGFS=y
CONFIG_WLAN_FEATURE_MIB_STATS=y
CONFIG_WLAN_LOG_FATAL=y
CONFIG_WLAN_LOG_ERROR=y
CONFIG_WLAN_LOG_WARN=y
CONFIG_WLAN_LOG_INFO=y
CONFIG_WLAN_LOG_DEBUG=y
CONFIG_WLAN_LOG_ENTER=y
CONFIG_WLAN_LOG_EXIT=y
CONFIG_ATH_PERF_PWR_OFFLOAD=y
CONFIG_HIF_SDIO=y
CONFIG_FEATURE_HL_GROUP_CREDIT_FLOW_CONTROL=y
CONFIG_TGT_NUM_MSDU_DESC=0
CONFIG_QCOM_ESE=y
CONFIG_WLAN_ENABLE_SOCIAL_CHANNELS_5G_ONLY=y
CONFIG_ATH_BUS_PM=y
CONFIG_PKT_LOG=y
CONFIG_PKTLOG_LEGACY=y
CONFIG_LITTLE_ENDIAN=y
CONFIG_QCA_WIFI_FTM=y
CONFIG_QCA_WIFI_FTM_NL80211=y
CONFIG_LINUX_QCMBR=y
CONFIG_CHECKSUM_OFFLOAD=y
CONFIG_GTK_OFFLOAD=y
CONFIG_TARGET_RAMDUMP_AFTER_KERNEL_PANIC=y
CONFIG_FEATURE_STATS_EXT=y
CONFIG_WLAN_DFS_STATIC_MEM_ALLOC=y
CONFIG_FEATURE_HTC_CREDIT_HISTORY=y
CONFIG_TRACE_RECORD_FEATURE=y
CONFIG_WLAN_FEATURE_P2P_DEBUG=y
CONFIG_FEATURE_ROAM_DEBUG=y
CONFIG_WLAN_DFS_MASTER_ENABLE=y
CONFIG_ENABLE_MTRACE_LOG=y
CONFIG_WLAN_NUD_TRACKING=y
CONFIG_WLAN_WBUFF=y
CONFIG_DISABLE_CHANNEL_LIST=y
CONFIG_WLAN_BCN_RECV_FEATURE=y
CONFIG_LTE_COEX=y
CONFIG_TARGET_11D_SCAN=y
CONFIG_SAP_AVOID_ACS_FREQ_LIST=y
CONFIG_HOST_OPCLASS=y
CONFIG_WLAN_DYNAMIC_CVM=y
CONFIG_SAR_SAFETY_FEATURE=y
CONFIG_CONNECTION_ROAMING_CFG=y
CONFIG_WIFI_POS_CONVERGED=y
CONFIG_CP_STATS=y
CONFIG_FEATURE_INTEROP_ISSUES_AP=y
CONFIG_FEATURE_WLAN_WAPI=y
CONFIG_FEATURE_FW_LOG_PARSING=y
CONFIG_PTT_SOCK_SVC_ENABLE=y
CONFIG_SOFTAP_CHANNEL_RANGE=y
CONFIG_FEATURE_WLAN_SCAN_PNO=y
CONFIG_WLAN_FEATURE_PACKET_FILTERING=y
CONFIG_WLAN_NS_OFFLOAD=y
CONFIG_FEATURE_WLAN_RA_FILTERING=y
CONFIG_FEATURE_WLAN_LPHB=y
CONFIG_QCA_SUPPORT_TX_THROTTLE=y
CONFIG_WMI_INTERFACE_EVENT_LOGGING=y
CONFIG_WLAN_FEATURE_LINK_LAYER_STATS=y
CONFIG_FEATURE_CLUB_LL_STATS_AND_GET_STATION=y
CONFIG_WMI_BCN_OFFLOAD=y
CONFIG_WLAN_PMO_ENABLE=y
CONFIG_CONVERGED_P2P_ENABLE=y
CONFIG_WLAN_POLICY_MGR_ENABLE=y
CONFIG_FEATURE_DENYLIST_MGR=y
CONFIG_FOURTH_CONNECTION=y
CONFIG_WLAN_CONV_SPECTRAL_ENABLE=y
CONFIG_WMI_CMD_STRINGS=y
CONFIG_FEATURE_MONITOR_MODE_SUPPORT=y
CONFIG_FW_THERMAL_THROTTLE=y
CONFIG_WLAN_FEATURE_BIG_DATA_STATS=y
CONFIG_WLAN_FEATURE_IGMP_OFFLOAD=y
CONFIG_WLAN_FEATURE_GET_USABLE_CHAN_LIST=y
CONFIG_FEATURE_RADAR_HISTORY=y
CONFIG_FEATURE_RSSI_MONITOR=y
CONFIG_FEATURE_BSS_TRANSITION=y
CONFIG_FEATURE_STATION_INFO=y
CONFIG_FEATURE_TX_POWER=y
CONFIG_FEATURE_OTA_TEST=y
CONFIG_FEATURE_ACTIVE_TOS=y
CONFIG_FEATURE_SAR_LIMITS=y
CONFIG_FEATURE_CONCURRENCY_MATRIX=y
CONFIG_FEATURE_SAP_COND_CHAN_SWITCH=y
CONFIG_FEATURE_P2P_LISTEN_OFFLOAD=y
CONFIG_QCACLD_RX_DESC_MULTI_PAGE_ALLOC=y
CONFIG_WMI_ROAM_SUPPORT=y
CONFIG_WMI_CONCURRENCY_SUPPORT=y
CONFIG_WMI_STA_SUPPORT=y
CONFIG_HIF_DEBUG=y
CONFIG_FEATURE_MEMDUMP_ENABLE=y
CONFIG_PLD_SDIO_CNSS_FLAG=y
CONFIG_FEATURE_OEM_DATA=y
CONFIG_WLAN_FW_OFFLOAD=y
CONFIG_WLAN_FEATURE_ELNA=y
CONFIG_WLAN_FEATURE_MDNS_OFFLOAD=y
CONFIG_WLAN_FEATURE_ICMP_OFFLOAD=y
CONFIG_WLAN_FEATURE_DP_BUS_BANDWIDTH=y
CONFIG_HANDLE_BC_EAP_TX_FRM=y
CONFIG_SAP_DHCP_FW_IND=y
CONFIG_ANI_LEVEL_REQUEST=y
CONFIG_DEBUG_RX_RING_BUFFER=y
CONFIG_RX_HASH_DEBUG=y
CONFIG_FEATURE_VDEV_OPS_WAKELOCK=y
CONFIG_WLAN_DEBUG_LINK_VOTE=y
CONFIG_QCACLD_WLAN_CONNECTIVITY_LOGGING=y
CONFIG_WLAN_FEATURE_CAL_FAILURE_TRIGGER=y
CONFIG_CFG80211_SINGLE_NETDEV_MULTI_LINK_SUPPORT=y
CONFIG_REG_CLIENT=y
CONFIG_160MHZ_SUPPORT=y
CONFIG_AGEIE_ON_SCAN_RESULTS=y
CONFIG_WLAN_FEATURE_BMI=y
CONFIG_WLAN_LOGGING_SOCK_SVC=y
CONFIG_WLAN_FEATURE_SAE=y
CONFIG_TUFELLO_DUAL_FW_SUPPORT=y
CONFIG_TX_DESC_HI_PRIO_RESERVE=y
CONFIG_HDD_INIT_WITH_RTNL_LOCK=y
CONFIG_WLAN_DEBUG_VERSION=y
CONFIG_WLAN_DIAG_VERSION=y
CONFIG_WLAN_SYSFS_FW_MODE_CFG=y
CONFIG_WLAN_SYSFS_MEM_STATS=y
CONFIG_WLAN_REASSOC=y
CONFIG_WLAN_SCAN_DISABLE=y
CONFIG_WLAN_WOW_ITO=y
CONFIG_WLAN_WOWL_ADD_PTRN=y
CONFIG_WLAN_WOWL_DEL_PTRN=y
CONFIG_WLAN_SYSFS_TX_STBC=y
CONFIG_WLAN_SYSFS_WLAN_DBG=y
CONFIG_WLAN_TXRX_FW_ST_RST=y
CONFIG_WLAN_GTX_BW_MASK=y
CONFIG_WLAN_SYSFS_SCAN_CFG=y
CONFIG_WLAN_SYSFS_MONITOR_MODE_CHANNEL=y
CONFIG_WLAN_SYSFS_RADAR=y
CONFIG_WLAN_TXRX_FW_STATS=y
CONFIG_WLAN_TXRX_STATS=y
CONFIG_WLAN_DL_MODES=y
CONFIG_DP_PKT_ADD_TIMESTAMP=y
CONFIG_WLAN_FEATURE_11W=y
CONFIG_WLAN_DEBUG_CRASH_INJECT=y
CONFIG_PANIC_ON_BUG=y
CONFIG_WLAN_WARN_ON_ASSERT=y
CONFIG_FEATURE_WLAN_MCC_TO_SCC_SWITCH=y
CONFIG_FEATURE_WLAN_AUTO_SHUTDOWN=y
CONFIG_FEATURE_WLAN_AP_AP_ACS_OPTIMIZE=y
CONFIG_FEATURE_WLAN_STA_4ADDR_SCHEME=y
CONFIG_MDM_PLATFORM=y
CONFIG_DFS_FCC_TYPE4_DURATION_CHECK=y
CONFIG_FEATURE_WLAN_STA_AP_MODE_DFS_DISABLE=y
CONFIG_FEATURE_AP_MCC_CH_AVOIDANCE=y
CONFIG_WLAN_WEXT_SUPPORT_ENABLE=y
```

## configs/qca6490.perf_defconfig
```kconfig
include $(WLAN_ROOT)/configs/default_defconfig

CONFIG_WLAN_FEATURE_MIB_STATS := n
CONFIG_FEATURE_MEMDUMP_ENABLE := n
CONFIG_FEATURE_UNIT_TEST_SUSPEND := n
CONFIG_WLAN_WBUFF := n
CONFIG_TSO_DEBUG_LOG_ENABLE := n
CONFIG_WLAN_FEATURE_P2P_DEBUG := n
CONFIG_DESC_DUP_DETECT_DEBUG := n
CONFIG_DEBUG_RX_RING_BUFFER := n
CONFIG_REMOVE_PKT_LOG := y
CONFIG_WDI_EVENT_ENABLE := n
CONFIG_WLAN_HANG_EVENT := n
CONFIG_FEATURE_VDEV_OPS_WAKELOCK := n
CONFIG_QCACLD_RX_DESC_MULTI_PAGE_ALLOC := n
CONFIG_RX_HASH_DEBUG := n
CONFIG_DP_MEM_PRE_ALLOC := n
CONFIG_MAX_ALLOC_PAGE_SIZE := n
CONFIG_UNIT_TEST := n
CONFIG_DSC_DEBUG := n
CONFIG_LEAK_DETECTION := n
CONFIG_TALLOC_DEBUG := n
CONFIG_HAL_DEBUG := n
CONFIG_HIF_DEBUG := n
CONFIG_QDF_TEST := n
CONFIG_HIF_CE_DEBUG_DATA_BUF := n
CONFIG_IPA_WDI3_TX_TWO_PIPES := n
CONFIG_HANDLE_RX_REROUTE_ERR := n
CONFIG_WLAN_FEATURE_DP_RX_RING_HISTORY := n
CONFIG_WLAN_FEATURE_DP_TX_DESC_HISTORY := n
CONFIG_REO_QDESC_HISTORY := n
CONFIG_DP_TX_HW_DESC_HISTORY := n
CONFIG_WLAN_FEATURE_DP_EVENT_HISTORY := n
CONFIG_RX_DESC_DEBUG_CHECK := n
CONFIG_QCACLD_WLAN_CONNECTIVITY_LOGGING := n
CONFIG_DP_TX_TRACKING := n
CONFIG_WLAN_DEBUG_LINK_VOTE := n
```

## configs/qca6490_defconfig
```kconfig
include $(WLAN_ROOT)/configs/default_defconfig
CONFIG_HIF_CPU_PERF_AFFINE_MASK := n
```
